// ----------- BLYNK CONFIG -----------
#define BLYNK_TEMPLATE_ID "TMPL3j_vV42SQ"
#define BLYNK_TEMPLATE_NAME "EnergyMonitor"
#define BLYNK_AUTH_TOKEN "x_7YwzI3i9MhfPMywr7iPn0iBGO_DhwQ"

#include <WiFi.h>
#include <BlynkSimpleEsp32.h>
#include <PZEM004Tv30.h>
#include <HardwareSerial.h>
#include <Wire.h>
#include <Adafruit_GFX.h>
#include <Adafruit_SH110X.h>

#define SCREEN_WIDTH 128
#define SCREEN_HEIGHT 64

int screenIndex = 0;
// ----------- WIFI -----------
char ssid[] = "Redmi 13C 5G";
char pass[] = "Aer0Dr@n01";

// ----------- OLED CONFIG -----------
Adafruit_SH1106G display(SCREEN_WIDTH, SCREEN_HEIGHT, &Wire, -1);
//------------ OLED ANIMATIONS--------
const unsigned char wifi_frames[][512] PROGMEM = {{0,0,0,0,0,0,0,0,0,0,0,0,0,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0,0},
  {0,0,0,0,0,0,0,0,0,0,0,0,0,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0,0},
  {0,0,0,0,0,0,0,0,0,0,0,0,0,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0,0},
  {0,0,0,0,0,0,0,0,0,0,0,0,0,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0,0},
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  {0,0,0,0,0,0,0,0,0,0,0,0,0,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0,0}};
const unsigned char emoji_frames[][512] PROGMEM = {{0,0,0,0,0,0,0,0,0,0,0,0,0,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0,0},
  {0,0,0,0,0,0,0,0,0,0,0,0,0,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0,0},
  {0,0,0,0,0,0,0,0,0,0,0,0,0,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0,0},
  {0,0,0,0,0,0,0,0,0,0,0,0,0,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0,0},
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  {0,0,0,0,0,0,0,0,0,0,0,0,0,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0,0}};
const unsigned char ghost_frames[][512] PROGMEM = {{0,0,0,0,0,0,0,0,0,0,0,0,0,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0,0},
  {0,0,0,0,0,0,0,0,0,0,0,0,0,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0,0},
  {0,0,0,0,0,0,0,0,0,0,0,0,0,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0,0},
  {0,0,0,0,0,0,0,0,0,0,0,0,0,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0,0},
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  {0,0,0,0,0,0,0,0,0,0,0,0,0,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0,0}};

#define WIFI_FRAME_COUNT   (sizeof(wifi_frames) / sizeof(wifi_frames[0]))
#define EMOJI_FRAME_COUNT  (sizeof(emoji_frames) / sizeof(emoji_frames[0]))
#define GHOST_FRAME_COUNT  (sizeof(ghost_frames) / sizeof(ghost_frames[0]))

void playAnimation(const uint8_t frames[][512], int count, int delayTime) {
  for (int i = 0; i < count; i++) {
    display.clearDisplay();
    display.drawBitmap(32, 0, frames[i], 64, 64, SH110X_WHITE);
    display.display();
    delay(delayTime);
  }
}

// ----------- PZEM CONFIG -----------
HardwareSerial mySerial(2);
PZEM004Tv30 pzem(mySerial, 16, 17);

// ----------- VARIABLES -----------
float voltage, current, power, energy, frequency;

BlynkTimer timer;

bool wifiConnected = false;
bool offlineMode = false ;
unsigned long wifiCheckTime = 0;
const long wifiCheckInterval = 60000;
// ----------- READ SENSOR -----------
void readPZEM() {
  voltage = pzem.voltage();
  current = pzem.current();
  power = pzem.power();
  energy = pzem.energy();
  frequency = pzem.frequency();

  Serial.println("------ SENSOR DATA ------");

  Serial.print("Voltage: "); Serial.println(voltage);
  Serial.print("Current: "); Serial.println(current);
  Serial.print("Power: "); Serial.println(power);
  Serial.print("Energy: "); Serial.println(energy);
  Serial.print("Frequency: "); Serial.println(frequency);

  if (wifiConnected && Blynk.connected()) {
    if (!isnan(voltage)) Blynk.virtualWrite(V0, voltage);
    if (!isnan(current)) Blynk.virtualWrite(V1, current);
    if (!isnan(power)) Blynk.virtualWrite(V2, power);
    if (!isnan(energy)) Blynk.virtualWrite(V3, energy);
    if (!isnan(frequency)) Blynk.virtualWrite(V4, frequency);
  }
}

// ----------- OLED DISPLAY -----------
void updateDisplay() {
  display.clearDisplay();
  display.setTextColor(SH110X_WHITE);

  if (isnan(voltage) || voltage < 10) {
    display.setTextSize(2);
    display.setCursor(20, 30);
    display.println("NO POWER");
    display.display();
    return;
  }

  display.setTextSize(1);

  switch (screenIndex) {

    case 0: // Voltage
      display.setCursor(30, 10);
      display.println("VOLTAGE");
      display.setTextSize(2);
      display.setCursor(35, 35);
      display.print(voltage, 1);
      break;

    case 1: // Current
      display.setTextSize(1);
      display.setCursor(30, 10);
      display.println("CURRENT");
      display.setTextSize(2);
      display.setCursor(35, 35);
      display.print(current, 2);
      break;

    case 2: // Power
      display.setTextSize(1);
      display.setCursor(35, 10);
      display.println("POWER");
      display.setTextSize(2);
      display.setCursor(35, 35);
      display.print(power, 1);
      break;

    case 3: // Energy
      display.setTextSize(1);
      display.setCursor(30, 10);
      display.println("ENERGY");
      display.setTextSize(2);
      display.setCursor(25, 35);
      display.print(energy, 3);
      break;

    case 4: // Frequency
      display.setTextSize(1);
      display.setCursor(15, 10);
      display.println("FREQUENCY");
      display.setTextSize(2);
      display.setCursor(30, 35);
      display.print(frequency, 1);
      break;
  }

  display.display();

  screenIndex++;
  if (screenIndex > 4) screenIndex = 0;
}

// ----------- SETUP -----------
void setup() {
  Serial.begin(115200);
  delay(2000);

  Serial.println("===== SYSTEM BOOT =====");

  // -------- OLED INIT --------
  Wire.begin(21, 22);
  Serial.println("Initializing OLED...");
  if (!display.begin(0x3C, true)) {
    Serial.println("❌ OLED Failed");
    while (1);
  }
display.clearDisplay();
display.display();
  Serial.println("✅ OLED OK");

// -------- WIFI CONNECT --------
Serial.println("Connecting to WiFi...");

int wifiAttempts = 0;

while (wifiAttempts < 3 && !wifiConnected) {

  WiFi.begin(ssid, pass);

  unsigned long startAttemptTime = millis();

  while (WiFi.status() != WL_CONNECTED &&
         millis() - startAttemptTime < 10000) {

    playAnimation(wifi_frames, WIFI_FRAME_COUNT, 80);
  }

  if (WiFi.status() == WL_CONNECTED) {

    wifiConnected = true;

    playAnimation(emoji_frames, EMOJI_FRAME_COUNT, 120);

    Serial.println("\n✅ WiFi Connected!");
    Serial.print("IP: ");
    Serial.println(WiFi.localIP());

  } else {

    wifiAttempts++;

    Serial.print("\n❌ Attempt ");
    Serial.print(wifiAttempts);
    Serial.println(" Failed");
  }
}

if (!wifiConnected) {
  offlineMode = true;
  Serial.println("Starting OFFLINE MODE");
  unsigned long ghostStart = millis();
  while (millis() - ghostStart < 3000) {
    playAnimation(ghost_frames, GHOST_FRAME_COUNT, 80);
  }
}
// -------- BLYNK CONNECT --------
if (wifiConnected) {
  Serial.println("Connecting to Blynk...");
  Blynk.config(BLYNK_AUTH_TOKEN);
  if (Blynk.connect(5000)) {
    Serial.println("✅ Blynk Connected!");
  } else {
    Serial.println("❌ Blynk Failed to Connect");
  }
}
else {

  Serial.println("⚠ Running Without Blynk");
}

  // -------- TIMERS --------
  timer.setInterval(2000L, readPZEM);
  timer.setInterval(2000L, updateDisplay);

  Serial.println("===== SYSTEM READY =====");
}
// ----------- LOOP -----------
void loop() {
  if (wifiConnected && Blynk.connected()) {
    Blynk.run();
  }
  timer.run();
  // -------- WIFI MONITOR --------
if (!offlineMode) {
  if (millis() - wifiCheckTime >= wifiCheckInterval) {
    wifiCheckTime = millis();
    if (WiFi.status() != WL_CONNECTED) {
      Serial.println("⚠ WiFi Disconnected!");
      Serial.println("Restarting ESP32...");
      delay(1000);
      ESP.restart();
    }
  }
}
}